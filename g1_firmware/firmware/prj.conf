## CMakeLists.txt
```
cmake_minimum_required(VERSION 3.20.0)
find_package(Zephyr REQUIRED HINTS $ENV{ZEPHYR_BASE})
project(g1v0)
# The VM core (protocol 5) is compiled in place from the ScouterKit tree, never copied.
file(REAL_PATH ${CMAKE_CURRENT_SOURCE_DIR} G1_APP_DIR)
get_filename_component(G1_SK_DIR ${G1_APP_DIR}/../.. ABSOLUTE)
set(G1_VM_DIR ${G1_SK_DIR}/src/vm)
target_sources(app PRIVATE
	src/early.S src/retained.c src/health.c src/board.c src/netcore.c
	src/pmic.c src/power.c src/imu.c src/diag.c src/caselink.c src/panel.c src/exec.c src/proto.c src/netfallback.c src/netimg.S src/main.c
	src/mic.c src/touch.c src/touchcfg.S src/light.c src/peer.c src/idle.c src/guard.c src/assets.c src/bonds.c
	src/fc.c src/fc_inflate.c src/ancs.c
	${G1_VM_DIR}/vm.c ${G1_VM_DIR}/vm_gfx.c)
target_include_directories(app PRIVATE ${G1_VM_DIR})
# DIAG BONDS reads the host's struct bt_keys (aging counter, key flags): its internal header, for this file only.
set_source_files_properties(src/bonds.c PROPERTIES INCLUDE_DIRECTORIES ${ZEPHYR_BASE}/subsys/bluetooth/host)
# The interpreter runs every host packet and program instruction: -O2 instead of the image's -Os.
set_source_files_properties(${G1_VM_DIR}/vm.c ${G1_VM_DIR}/vm_gfx.c PROPERTIES COMPILE_OPTIONS "-O2")
set_source_files_properties(src/fc.c src/fc_inflate.c PROPERTIES COMPILE_OPTIONS "-O2")
# liblc3 (Apache-2.0, vendored with its licence): the LC3 encoder of the microphone, 10 ms frames only.
set(G1_LC3_DIR ${G1_SK_DIR}/third_party/liblc3)
file(GLOB G1_LC3_SRC ${G1_LC3_DIR}/src/*.c)
target_sources(app PRIVATE ${G1_LC3_SRC})
target_include_directories(app PRIVATE ${G1_LC3_DIR}/include)
set_source_files_properties(${G1_LC3_SRC} PROPERTIES
	COMPILE_OPTIONS "-std=c11;-O3;-ffast-math;-Wno-unused-parameter;-Wno-double-promotion"
	COMPILE_DEFINITIONS "LC3_PLUS=0;LC3_PLUS_HR=0")
# The first instructions after reset go through early.S (WDT0 handling), then into Zephyr.
zephyr_ld_options(-Wl,--wrap=z_arm_reset)
# Even's net-core image embedded for the self-fallback (src/netimg.S, src/netfallback.c), fetched by
# scripts/fetch_stock.sh 1.6.6 into the work directory; never part of this tree.
set(G1_NET_IMAGE $ENV{G1_WORK}/firmware/1.6.6/net_core_app_update.bin CACHE FILEPATH "net image for the self-fallback")
if(NOT EXISTS ${G1_NET_IMAGE})
	message(FATAL_ERROR "${G1_NET_IMAGE} not found: run scripts/fetch_stock.sh 1.6.6")
endif()
set(G1_NET_IMAGE_NAME 1.6.6 CACHE STRING "version label of G1_NET_IMAGE")
set_source_files_properties(src/netimg.S PROPERTIES
	COMPILE_DEFINITIONS "G1_NET_IMAGE_PATH=\"${G1_NET_IMAGE}\"" OBJECT_DEPENDS ${G1_NET_IMAGE})
set_source_files_properties(src/netfallback.c PROPERTIES
	COMPILE_DEFINITIONS "G1_NET_IMAGE_NAME=\"${G1_NET_IMAGE_NAME}\"")
# The TouchBar controller's configuration table, as stock loads it (src/touchcfg.S, src/touch.c), taken from
# Even's 1.6.6 image by scripts/fetch_stock.sh 1.6.6 into the work directory; never part of this tree.
set(G1_TOUCH_TABLE $ENV{G1_WORK}/fw/1.6.6_aw9320x_table.bin CACHE FILEPATH "TouchBar controller table")
if(NOT EXISTS ${G1_TOUCH_TABLE})
	message(FATAL_ERROR "${G1_TOUCH_TABLE} not found: run scripts/fetch_stock.sh 1.6.6")
endif()
set_source_files_properties(src/touchcfg.S PROPERTIES
	COMPILE_DEFINITIONS "G1_TOUCH_TABLE_PATH=\"${G1_TOUCH_TABLE}\"" OBJECT_DEPENDS ${G1_TOUCH_TABLE})
```

## Kconfig
```
config G1_FAULT_INJECTION
	bool "Accept the FAULT control request (test builds only)"
	default y

config G1_WDT0_CRV
	int "nRF WDT0 reload value when this image starts it (32768 = 1 s)"
	default 3932160
	help
	  120 s. WDT0 keeps running through the soft reset into MCUboot and nothing may feed it during
	  an install (the genuine MCUboot's feeding is unverified), so it must outlast the whole install:
	  DK (D1) stock 976 KB 36.8 s; arm worst case ~44 s (240 pages x 89.7 ms erase, slower genuine
	  QSPI reads), ~56 s with a PCD net update in the same pass. The health thread feeds WDT0 every
	  0.5 s and reboots by itself on a thread hang (< 5 s), so only a total hang waits for WDT0;
	  with the nPM1300 watchdog armed (30 s, power cycle) that one comes first. A running WDT0
	  keeps its CRV until a watchdog, pin or power-on reset.

config G1_NET_ESB_QUIET
	bool "Tell the stock net core to quiesce its arm-to-arm ESB link (work mode 1, as stock's DFU mode)"
	default n
	help
	  Off since 0.5.0 (power.md §5, ESB mode): with work mode 1 on both arms the right arm (ESB master) missed most
	  BLE connection events under traffic (in the case, 0.4–1.4 KB/s and a link loss every 5–15 s, reason
	  0x28 Instant Passed), across power cycles; mode 0 on both arms gave 12–13 KB/s with no loss. Mode 0
	  as stock: both arms must run the same mode (an arm in mode 0 whose partner is quiet loses its links).

config G1_NET_FALLBACK_BOOTS
	int "Reflash the net core after this many consecutive boots without Bluetooth (M)"
	default 3

config G1_NET_FALLBACK_TIMEOUT_S
	int "A boot without Bluetooth after this many seconds reboots and counts as failed (N)"
	default 30

config G1_REQUIRE_SECURITY
	bool "Out of the case, require an encrypted, bonded link for every write (CMD, CTRL, SMP)"
	default y

config G1_PAIRING_WINDOW_S
	int "Seconds after boot during which a new bond may be created out of the case"
	default 0
	help
	  0 on the arm: bondable only in the case (VBUS), per the user's rule. The nRF5340 DK build
	  sets 120, since a bare DK has no PMIC and so is never "in the case".

config G1_CASE_LINK
	bool "Answer the charging case's requests over the ST25DV mailbox as stock (battery status: charging, full)"
	default y if !G1_NO_PANEL
	help
	  Without the reply the case never learns that the battery is full and keeps its NFC power transfer
	  on (power.md). Needs the ST25DV on TWIM1 and its GPO on P1.10 (the arm; the DK has neither).

config G1_IN_CASE_HOLD_S
	int "IN_CASE stays 1 this many seconds after the last VBUS sample, tag field or case message, unless the arm moved"
	default 400
	help
	  VM.md §2.5: a full case re-checks an arm about every 300 s. The emulator test build uses less.

config G1_PANEL_IDLE_S
	int "With no host connected and no running program, the panel goes off this many seconds after the last DRAW"
	default 30
	help
	  VM.md §6.6. The emulator test build uses a few seconds: its emulated net core stalls when the arm
	  advertises much longer (emulator.md §10.15).

config G1_PANEL_BUDGET_MA
	int "The panel guard's discharge budget, mA: above it the panel's level is capped"
	range 80 150
	default 100
	help
	  VM.md §6.6: while the panel is on and the arm runs on its battery, the mean IBAT (the whole arm's) above
	  this lowers BRIGHTNESS_CAP. 100 (1.25 C of the 80 mAh cell) since the acceptance run of 2026-11-04: at 120 the
	  right arm's pack rose 6.7 °C in 12 min of white (docs/review-dimming.md points 9 and 14, docs/power.md §17).

config G1_GUARD_BURST_MS
	int "While the panel is on, each PMIC round's 16 VBAT+IBAT conversions span at least this many ms"
	range 40 200
	default 40
	help
	  VM.md §6.6: the panel's current is pulsed; the burst covers at least two pulse periods (docs/power.md §17).

config G1_MIC_ANY_LINK
	bool "Emulator test build: MIC on an unencrypted link; never on an arm"
	default n
	help
	  VM.md §6.5: MIC needs an encrypted link, in the case too. The emulator's virtual central cannot
	  pair, so its test build sets this to exercise the capture, the indicator and the stop rules.

config G1_ANCS_ANY_LINK
	bool "Emulator test build: the ANCS relay on an unencrypted link; never on an arm"
	default n
	help
	  VM.md §6.12: the relay needs an encrypted link, in the case too. The emulator's virtual central cannot pair.

config G1_MIC_128MHZ
	bool "Run the app core at 128 MHz while the microphone captures"
	default n
	help
	  The LC3 encoder takes ~160k cycles per 10 ms frame: 25 % of the 64 MHz core, 12.5 % at 128 MHz.
	  Off as the codec review decided (docs/audio-codec.md: a cycle costs ~10 % more energy at 128 MHz, and
	  the encoder thread starves nothing at 64 MHz); test builds can switch it with DIAG SET 5.

config G1_IMU_BASE_DEFAULT
	int "Stock's IMU pitch base (centidegrees) for an arm whose settings record has none (0)"
	default -1987
	help
	  The head frame's tilt against the arm's board (imu.c). Stock's factory test stored it on the right
	  arm only (+0x0C of the settings record; -1987 on the development unit) and left the left arm's at 0,
	  stock's "no base": the glasses are rigid, so the left arm uses this value, until a worn calibration.

config G1_NO_PANEL
	bool "Board without a panel (the nRF5340 DK build); reported in HELLO and the pair record"
	default n

config G1_DK_NCS_NET
	bool "DK bench: the net core runs NCS's hci_rpmsg (no stock handshake, no ESB)"
	depends on G1_NO_PANEL
	default n

source "Kconfig.zephyr"
```

## prj.conf
```kconfig
# g1v0: scouter firmware for the G1 app core, protocol 5 (scouter_kit/g1_firmware/docs/VM.md).
CONFIG_BOOTLOADER_MCUBOOT=y
CONFIG_MCUBOOT_IMGTOOL_SIGN_VERSION="0.5.28+0"
CONFIG_UPDATEABLE_IMAGE_NUMBER=2
CONFIG_NRF53_UPGRADE_NETWORK_CORE=y
CONFIG_ADD_MCUBOOT_MEDIATE_SIM_FLASH_DTS=y

CONFIG_BT=y
CONFIG_BT_PERIPHERAL=y
CONFIG_BT_DEVICE_NAME="G1CFW"
CONFIG_BT_DEVICE_NAME_DYNAMIC=y
CONFIG_BT_MAX_CONN=1
CONFIG_BT_USER_PHY_UPDATE=y
CONFIG_BT_USER_DATA_LEN_UPDATE=y
CONFIG_BT_GAP_AUTO_UPDATE_CONN_PARAMS=n
CONFIG_BT_L2CAP_TX_MTU=247
CONFIG_BT_BUF_ACL_RX_SIZE=251
CONFIG_BT_BUF_ACL_TX_SIZE=251
CONFIG_BT_BUF_ACL_RX_COUNT=16
CONFIG_BT_BUF_ACL_TX_COUNT=8
CONFIG_BT_L2CAP_TX_BUF_COUNT=8
CONFIG_BT_CONN_TX_MAX=8
# The GATT client below runs in this thread's callbacks.
CONFIG_BT_RX_STACK_SIZE=2560
# The iPhone notification relay (ancs.c): a client of the phone's ANCS, on the link the phone itself made. Its
# subscriptions never outlive a link, so nothing is restored at a reconnection.
CONFIG_BT_GATT_CLIENT=y
CONFIG_BT_GATT_AUTO_RESUBSCRIBE=n

CONFIG_NCS_SAMPLE_MCUMGR_BT_OTA_DFU=y
CONFIG_MCUMGR_GRP_OS_ECHO=y
CONFIG_MCUMGR_TRANSPORT_BT_CONN_PARAM_CONTROL=n
CONFIG_MCUMGR_MGMT_NOTIFICATION_HOOKS=y
CONFIG_MCUMGR_GRP_OS_RESET_HOOK=y
# The OTA sample turns on the zephyr-basic group with NVS settings: its only command erases the settings
# partition (every bond). Nothing uses it (flash.py, the asset store): off (0.5.58).
CONFIG_MCUMGR_GRP_ZBASIC=n

CONFIG_IPC_SERVICE=y
CONFIG_IPC_SERVICE_BACKEND_RPMSG_NUM_ENDPOINTS_PER_INSTANCE=2

# Hardware floating point: the LC3 encoder of the microphone (mic.c) and the IMU's angles.
CONFIG_FPU=y
CONFIG_FPU_SHARING=y

# Device power management only for the idle bisect's TWIM2 switch (idle.c, test builds); nothing suspends a device
# by itself (no CONFIG_PM).
CONFIG_PM_DEVICE=y
CONFIG_GPIO=y
CONFIG_I2C=y
CONFIG_ADC=y
# Panel SPIM4 is driven by panel.c directly (32 MHz, as stock), not by the Zephyr SPI driver.
CONFIG_SPI=n
CONFIG_FLASH=y
# The asset store's put verifies its read-back with SHA-256 (assets.c).
CONFIG_TINYCRYPT=y
CONFIG_TINYCRYPT_SHA256=y
CONFIG_CRC=y
CONFIG_REBOOT=y
CONFIG_ENTROPY_GENERATOR=y

CONFIG_LOG=y
CONFIG_LOG_MODE_DEFERRED=y
CONFIG_LOG_BUFFER_SIZE=4096
CONFIG_LOG_PROCESS_THREAD_SLEEP_MS=1000
CONFIG_PRINTK=y
# The console UART has no receiver (app.overlay disable-rx): Zephyr's UARTE driver then runs it in
# low-power mode, off between transmissions; an enabled receiver kept the HF clock running for good.
CONFIG_MAIN_STACK_SIZE=4096
CONFIG_SYSTEM_WORKQUEUE_STACK_SIZE=2048
CONFIG_RESET_ON_FATAL_ERROR=n
CONFIG_THREAD_NAME=y
# CPU load for the POWER telemetry (idle vs busy cycles)
CONFIG_THREAD_RUNTIME_STATS=y
CONFIG_SCHED_THREAD_USAGE=y
CONFIG_SCHED_THREAD_USAGE_ALL=y
CONFIG_MCUMGR_SMP_COMMAND_STATUS_HOOKS=y

# Security (docs/protocol.md §: bonding mirrors stock). LE Secure Connections, Just Works
# (NoInputNoOutput), bonds in the settings partition. The write gate is enforced in the handlers
# (in-case VBUS bypasses it), so the GATT permissions stay plain.
CONFIG_BT_SMP=y
CONFIG_BT_SMP_SC_PAIR_ONLY=y
CONFIG_BT_BONDABLE=y
# Pairing must create a bond (a pairing request without the bonding flag is rejected), so an
# encrypted link out of the case always means a bonded peer.
CONFIG_BT_BONDING_REQUIRED=y
CONFIG_BT_MAX_PAIRED=3
# A new bond (only possible in the case) replaces the oldest one when all 3 are used; otherwise no new
# host could ever bond (g1v0 has no unpair command).
CONFIG_BT_KEYS_OVERWRITE_OLDEST=y
# Store a bond's aging counter whenever another bond becomes the most recently used (each change of host),
# so "oldest" means least recently used across reboots too, not only within one boot (0.5.58).
CONFIG_BT_KEYS_SAVE_AGING_COUNTER_ON_PAIRING=y
# A host that lost its bond may pair again (in the case) over the arm's old Just Works bond for its
# address; Zephyr refuses that by default. Out of the case pairing is still refused (not bondable).
CONFIG_BT_SMP_ALLOW_UNAUTH_OVERWRITE=y
CONFIG_BT_SETTINGS=y
CONFIG_SETTINGS=y
CONFIG_NVS=y
CONFIG_FLASH_MAP=y
```

## src/main.c
```c
/* g1v0 boot order (firmware-plan.md §6): retained-RAM accounting, watchdog feeding, then BLE + SMP
 * first; PMIC and panel run in their own threads so they can never hold up DFU. */
#include <stdio.h>
#include <string.h>
#include <zephyr/sys/byteorder.h>
#include <zephyr/kernel.h>
#include <zephyr/bluetooth/bluetooth.h>
#include <zephyr/bluetooth/conn.h>
#include <zephyr/bluetooth/uuid.h>
#include <zephyr/mgmt/mcumgr/mgmt/callbacks.h>
#include <zephyr/logging/log.h>
#include <zephyr/settings/settings.h>
#include <nrf.h>
#include "g1.h"
#include "netfallback.h"

LOG_MODULE_REGISTER(g1v0, LOG_LEVEL_INF);

void retained_log_boot_banner(void);

static char name[16];

/* The arm keeps the Bluetooth address Even's firmware has (Zephyr's default: the net core's static address, or what
 * the settings hold), so a host's bond and what it remembers about the arm survive an install in either direction.
 * Called once the identity is known, after settings_load(). The name tells the pairs in a room apart: stock's names
 * end in the same six hex digits. */
static void set_name(void)
{
	bt_addr_le_t id = {0};
	size_t count = 1;

	bt_id_get(&id, &count);
	snprintf(name, sizeof(name), "G1CFW_%c_%02X%02X%02X", board_role() ? 'L' : 'R', id.a.val[2], id.a.val[1], id.a.val[0]);
}

static void adv_restart(struct k_work *work);
static K_WORK_DELAYABLE_DEFINE(adv_work, adv_restart);

/* Advertising (VM.md §6.6): 100-150 ms for 60 s after boot or a disconnection and whenever in the case
 * (IN_CASE), then 1 s (1000-1100 ms). The switch is a stop and a start with the same data. */
#define ADV_FAST_S 60
static const struct bt_le_adv_param adv_fast = BT_LE_ADV_PARAM_INIT(BT_LE_ADV_OPT_CONNECTABLE,
	BT_GAP_ADV_FAST_INT_MIN_2, BT_GAP_ADV_FAST_INT_MAX_2, NULL);
static const struct bt_le_adv_param adv_slow_param = BT_LE_ADV_PARAM_INIT(BT_LE_ADV_OPT_CONNECTABLE,
	0x0640, 0x06E0, NULL);
static volatile bool adv_on, adv_is_slow, adv_ready;
static int64_t fast_until;

/* The pair record (VM.md §6.1): manufacturer data without a company ID (0xFFFF), format 2, flags, the firmware's
 * version, then the frame serial, or the chip's device ID in hex on a board without one. Fixed for the whole boot,
 * so the advertising data is never updated while advertising. */
static size_t pair_record(uint8_t *b)
{
	size_t n = strlen(g1_settings.serial);

	b[0] = 0xFF;
	b[1] = 0xFF;
	b[2] = 2;
	b[3] = board_role() | (IS_ENABLED(CONFIG_G1_NO_PANEL) ? 2 : 0) | (n ? 4 : 0) | (safe_level() ? 8 : 0);
	proto_version(&b[4]);
	if (n) {
		memcpy(&b[7], g1_settings.serial, n);
	} else {
		n = snprintf((char *)&b[7], 17, "%08X%08X", NRF_FICR_S->INFO.DEVICEID[1], NRF_FICR_S->INFO.DEVICEID[0]);
	}
	return 7 + n;
}

static void adv_restart(struct k_work *work)
{
	uint8_t rec[7 + 17];
	const struct bt_data ad[] = {
		BT_DATA_BYTES(BT_DATA_FLAGS, (BT_LE_AD_GENERAL | BT_LE_AD_NO_BREDR)),
		BT_DATA(BT_DATA_NAME_COMPLETE, name, strlen(name)),
	};
	const struct bt_data sd[] = {
		BT_DATA(BT_DATA_MANUFACTURER_DATA, rec, pair_record(rec)),
	};
	int err;

	bool slow = !g1_in_case() && k_uptime_get() >= fast_until;

	if (proto_connected()) {
		adv_on = false;
		return;
	}
	if (adv_on && slow == adv_is_slow) {
		return;
	}
	if (adv_on) {
		bt_le_adv_stop();
		adv_on = false;
	}
	err = bt_le_adv_start(slow ? &adv_slow_param : &adv_fast, ad, ARRAY_SIZE(ad), sd, ARRAY_SIZE(sd));
	if (err && err != -EALREADY) {
		LOG_ERR("advertising failed: %d, retrying", err);
		k_work_schedule(&adv_work, K_SECONDS(1));
		return;
	}
	adv_on = true;
	adv_is_slow = slow;
	if (!slow && !g1_in_case()) {
		k_work_schedule(&adv_work, K_TIMEOUT_ABS_MS(fast_until));
	}
}

bool adv_slow(void)
{
	return adv_on && adv_is_slow;
}

/* after a disconnection: fast again for 60 s */
void adv_kick(void)
{
	adv_on = false;
	fast_until = k_uptime_get() + ADV_FAST_S * 1000;
	k_work_schedule(&adv_work, K_MSEC(200));
}

/* IN_CASE changed: in the case fast, out of it the 60 s rule */
void adv_vbus_changed(void)
{
	if (!adv_ready) {
		return;   /* before bt_enable: main starts advertising */
	}
	if (!g1_in_case() && fast_until < k_uptime_get() + 1000) {
		fast_until = k_uptime_get();
	}
	k_work_schedule(&adv_work, K_NO_WAIT);
}

static enum mgmt_cb_return smp_reset_hook(uint32_t event, enum mgmt_cb_return prev_status, int32_t *rc,
					  uint16_t *group, bool *abort_more, void *data, size_t data_size)
{
	retained_mark_clean(CLEAN_SMP, true, false);
	LOG_INF("SMP reset requested");
	g1_prepare_reboot();
	return MGMT_CB_OK;
}

static struct mgmt_callback smp_reset_cb = {
	.callback = smp_reset_hook,
	.event_id = MGMT_EVT_OP_OS_MGMT_RESET,
};

static enum mgmt_cb_return smp_rx_hook(uint32_t event, enum mgmt_cb_return prev_status, int32_t *rc,
				       uint16_t *group, bool *abort_more, void *data, size_t data_size)
{
	if (!proto_writes_allowed()) {
		*rc = MGMT_ERR_EACCESSDENIED;
		*abort_more = true;
		return MGMT_CB_ERROR_RC;
	}
	health_bt_traffic();
	return MGMT_CB_OK;
}

static struct mgmt_callback smp_rx_cb = {
	.callback = smp_rx_hook,
	.event_id = MGMT_EVT_OP_CMD_RECV,
};

int main(void)
{
	int err;
	bool ble_up;

	retained_boot();
	retained_log_boot_banner();
	health_start();
	LOG_INF("g1v0 %s booting: safe level %u, unhealthy boots %u, boot %u, RESETREAS 0x%08x",
		CONFIG_MCUBOOT_IMGTOOL_SIGN_VERSION, safe_level(), retained_unhealthy(), retained_boot_count(),
		retained_resetreas());
	mgmt_callback_register(&smp_reset_cb);
	mgmt_callback_register(&smp_rx_cb);
	board_init();
	if (safe_level() < 2) {
		pmic_start();
	}
	caselink_start();
	touch_start();
	proto_init();
	exec_start();
	diag_netoff_boot();
	if (netfallback_boot()) {
		g1_reboot(CLEAN_HOST, false, false);
	}
	/* The net core must give us HCI. If the handshake does not complete we must NOT call bt_enable:
	 * with a dead net core its first HCI command would time out and Zephyr's BT_ASSERT would reset
	 * the arm (the same 10 s timeout as the SMP-upload risk). A failed handshake instead goes to the
	 * net-core fallback (netfallback.c). */
	err = IS_ENABLED(CONFIG_G1_DK_NCS_NET) ? 0 :
	      g1_netcore_handshake(board_role() ? 2 : 1, g1_settings.esb_channel, g1_settings.esb_master,
				   g1_settings.esb_slave);
	ble_up = false;
	if (err) {
		LOG_ERR("net core handshake failed: %d; not enabling Bluetooth this boot", err);
	} else {
		for (int i = 0; i < 5; i++) {
			k_sleep(K_MSEC(i == 0 ? 100 : 800));
			err = bt_enable(NULL);
			if (!err || err == -EALREADY) {
				ble_up = true;
				break;
			}
			LOG_WRN("bt_enable: %d, retrying", err);
		}
	}
	if (ble_up) {
		if (IS_ENABLED(CONFIG_BT_SETTINGS)) {
			settings_load();
		}
		proto_update_bondable();
		health_set_ble_up();
		netfallback_ble_up();
	}
	if (!ble_up) {
		LOG_ERR("no Bluetooth this boot (%u consecutive)", retained_net_fails());
		if (!retained_net_fallback_done()) {
			k_sleep(K_SECONDS(2));
			g1_reboot(CLEAN_HOST, false, false);
		}
		LOG_WRN("net fallback already used; staying up without BLE (panel/charging/health) for recovery");
		return 0;
	}
	set_name();
	bt_set_name(name);
	fast_until = k_uptime_get() + ADV_FAST_S * 1000;
	adv_ready = true;
	k_work_schedule(&adv_work, K_NO_WAIT);
	LOG_INF("advertising as %s, SMP ready", name);
	if (safe_level() == 1 && pmic_wait_ready(K_SECONDS(5))) {
		pmic_panel_rails(false);
		LOG_WRN("safe mode: panel rails off, drawing disabled");
	}
	return 0;
}
```

## src/ancs.c
```c
/* The iPhone notification relay (VM.md §6.12): the arm is the ANCS consumer, as a GATT client on its one link, and hands
 * what it hears to the app at the other end of that same link. The app owns everything else: it asks for attributes,
 * keeps the notifications and draws them. Nothing here reads a notification, and nothing is kept past the link.
 *
 *   BT thread:  ancs_command(), the GATT callbacks and ancs_link_down() run the state machine and fill the ring
 *   evt thread: ancs_take() empties the ring, because a notification may wait for a buffer and the BT thread must not
 *
 * Without a START from the host this file does nothing, so a host that isn't an iPhone never sees a GATT request.
 *
 * The authority is the connection, not the token: a frame in the ring goes to the connection that asked for it, through
 * a reference that also keeps the connection object from being reused. The token only lets the host reject old frames.
 * There is no lease and no way back to a stock consumer, because g1v0 has none: the link's end is what ends the relay. */
#include <string.h>
#include <zephyr/kernel.h>
#include <zephyr/bluetooth/conn.h>
#include <zephyr/bluetooth/gatt.h>
#include <zephyr/bluetooth/uuid.h>
#include <zephyr/logging/log.h>
#include "g1.h"

LOG_MODULE_REGISTER(ancs, LOG_LEVEL_INF);

#define CMD_HEAD 8
#define MAX_CMD 80
#define FRAME_HEAD 11
#define MAX_VALUE 512
/* About 400 Notification Source frames, or several attribute responses, behind the link. */
#define RING_SIZE 8192

enum { CMD_START = 0, CMD_STOP = 1, CMD_CP = 2 };
enum { KIND_STATUS = 0, KIND_NS = 1, KIND_DS = 2, KIND_CP_DONE = 3 };
enum { STATUS_RESETTING = 0, STATUS_READY = 1, STATUS_FAILED = 2, STATUS_NO_ANCS = 3 };
enum { FLAG_FIRST = 1, FLAG_LAST = 2 };

enum stage {
	S_IDLE,
	S_CLOSE_NS, S_CLOSE_DS,                                     /* a CCC = 0 is out */
	S_FIND_SERVICE, S_FIND_CHARS, S_FIND_NS_CCC, S_FIND_DS_CCC,
	S_SUB_DS, S_NS_OFF, S_SUB_NS,                               /* a CCC write is out */
	S_ACTIVE,
};

static struct bt_uuid_128 ancs_uuid = BT_UUID_INIT_128(BT_UUID_128_ENCODE(0x7905f431, 0xb5ce, 0x4e99, 0xa40f, 0x4b1e122d00d0));
static struct bt_uuid_128 ns_uuid = BT_UUID_INIT_128(BT_UUID_128_ENCODE(0x9fbf120d, 0x6301, 0x42d9, 0x8c58, 0x25e699a21dbd));
static struct bt_uuid_128 cp_uuid = BT_UUID_INIT_128(BT_UUID_128_ENCODE(0x69d1d8f3, 0x45e1, 0x49a8, 0x9821, 0x9bbdfdaad9d9));
static struct bt_uuid_128 ds_uuid = BT_UUID_INIT_128(BT_UUID_128_ENCODE(0x22eac6e9, 0x24d6, 0x4bb5, 0xbe44, 0xb36ace7c7bfb));
static struct bt_uuid_16 ccc_uuid = BT_UUID_INIT_16(BT_UUID_GATT_CCC_VAL);

/* the ring and the connection it sends on; the BT thread alone writes relay_conn, under the lock */
static struct k_spinlock ring_lock;
static uint8_t ring[RING_SIZE];
static uint32_t ring_head, ring_used, ring_drops;
static struct bt_conn *relay_conn;

/* BT thread only */
static enum stage stage;
static uint32_t token;
static uint16_t sequence;
static bool stop_pending;   /* STOP came while a request was out: it takes effect at the answer */
static bool ns_on, ds_on;   /* this link's CCC was or may have been set */
static bool subs_added;     /* ns_sub and ds_sub are in Zephyr's list, which they leave when the link ends */
static bool cp_busy;
static uint16_t service_end, ns_value, ns_ccc, cp_value, ds_value, ds_ccc;
static struct bt_gatt_discover_params discover;
static struct bt_gatt_subscribe_params ns_sub, ds_sub;
static struct bt_gatt_write_params ccc_write, cp_write;
static uint8_t cp_buf[MAX_CMD - CMD_HEAD];
static const uint8_t ccc_off[2], ccc_on[2] = {BT_GATT_CCC_NOTIFY, 0};

static void find_service(void);
static void close_relay(void);

static void ring_flush(void)
{
	k_spinlock_key_t key = k_spin_lock(&ring_lock);

	memset(ring, 0, sizeof(ring));
	ring_head = ring_used = 0;
	k_spin_unlock(&ring_lock, key);
}

/* A frame in the ring: u8 length, the head, the body. */
static bool ring_put(const uint8_t *head, const uint8_t *body, size_t n)
{
	size_t total = 1 + FRAME_HEAD + n;
	k_spinlock_key_t key = k_spin_lock(&ring_lock);
	bool room = ring_used + total <= RING_SIZE;

	if (room) {
		uint32_t at = (ring_head + ring_used) % RING_SIZE;

		ring[at] = FRAME_HEAD + n;
		for (size_t i = 0; i < FRAME_HEAD + n; i++) {
			ring[(at + 1 + i) % RING_SIZE] = i < FRAME_HEAD ? head[i] : body[i - FRAME_HEAD];
		}
		ring_used += total;
	} else {
		ring_drops++;
	}
	k_spin_unlock(&ring_lock, key);
	return room;
}

/* The next frame and a reference to the connection it belongs to, which the caller drops; NULL when there is none.
 * What the host has been sent is erased from the ring. */
struct bt_conn *ancs_take(uint8_t *out, uint8_t *len)
{
	struct bt_conn *c = NULL;
	k_spinlock_key_t key = k_spin_lock(&ring_lock);

	if (ring_used && relay_conn) {
		uint8_t n = ring[ring_head];

		ring[ring_head] = 0;
		for (uint8_t i = 0; i < n; i++) {
			uint32_t at = (ring_head + 1 + i) % RING_SIZE;

			out[i] = ring[at];
			ring[at] = 0;
		}
		ring_head = (ring_head + 1 + n) % RING_SIZE;
		ring_used -= 1 + n;
		*len = n;
		c = bt_conn_ref(relay_conn);
	}
	k_spin_unlock(&ring_lock, key);
	return c;
}

/* One value as frames that fit the MTU. A frame the ring has no room for still takes its sequence number, so the host
 * sees the gap and starts over. */
static void emit(uint8_t kind, const uint8_t *data, uint16_t len)
{
	uint16_t mtu = relay_conn ? bt_gatt_get_mtu(relay_conn) : 0;
	uint16_t room, off = 0;

	if (mtu < 23) {
		return;
	}
	room = MIN(mtu - 3, MAX_PKT) - FRAME_HEAD;
	do {
		uint16_t count = MIN(len - off, room);
		uint8_t head[FRAME_HEAD] = {'A', 'N', 1, kind};

		put32(&head[4], token);
		put16(&head[8], sequence++);
		head[10] = (off == 0 ? FLAG_FIRST : 0) | (off + count == len ? FLAG_LAST : 0);
		if (!ring_put(head, data ? data + off : NULL, count)) {
			LOG_WRN("ring full, frame dropped");
		}
		off += count;
	} while (off < len);
	proto_ancs_kick();
}

static void emit_status(uint8_t status)
{
	emit(KIND_STATUS, &status, 1);
}

static void fail(uint8_t status)
{
	LOG_WRN("relay failed in stage %d: status %u", stage, status);
	emit_status(status);
	close_relay();
}

static void ccc_done(struct bt_conn *c, uint8_t err, struct bt_gatt_write_params *p);

/* The relay writes its CCCs itself. bt_gatt_subscribe's and bt_gatt_unsubscribe's writes report to no one when the phone
 * refuses the unsubscribe of the last subscription (gatt_write_ccc_rsp finds no list and returns), and iOS can refuse
 * once it has withdrawn ANCS; bt_gatt_write always answers, also when the link ends. */
static int write_ccc(uint16_t handle, const uint8_t *value)
{
	ccc_write = (struct bt_gatt_write_params){.func = ccc_done, .handle = handle, .data = value, .length = 2};
	return bt_gatt_write(relay_conn, &ccc_write);
}

/* CCC = 0 for what was set, one write at a time, then idle. A refused or impossible write doesn't matter: what still
 * arrives is ignored, and the link's end clears it. */
static void close_next(void)
{
	while (ns_on || ds_on) {
		uint16_t handle = ns_on ? ns_ccc : ds_ccc;

		stage = ns_on ? S_CLOSE_NS : S_CLOSE_DS;
		if (ns_on) {
			ns_on = false;
		} else {
			ds_on = false;
		}
		if (handle && !write_ccc(handle, ccc_off)) {
			return;
		}
	}
	stage = S_IDLE;
	token = 0;
}

static void close_relay(void)
{
	stop_pending = false;
	close_next();
}

/* True when a STOP that waited for this answer took over. */
static bool stop_taken(void)
{
	if (!stop_pending) {
		return false;
	}
	close_relay();
	return true;
}

static uint8_t received(struct bt_conn *c, struct bt_gatt_subscribe_params *p, const void *data, uint16_t len)
{
	if (!data) {
		/* Zephyr took the subscriptions off its list: they go together. */
		subs_added = false;
		return BT_GATT_ITER_STOP;
	}
	if (stop_pending) {
		return BT_GATT_ITER_CONTINUE;
	}
	/* iOS may send before it answers the CCC write; the host holds these until it is told the relay is ready. */
	if (p == &ns_sub && (stage == S_SUB_NS || stage == S_ACTIVE) && len == 8) {
		emit(KIND_NS, data, len);
	} else if (p == &ds_sub && stage == S_ACTIVE && len && len <= MAX_VALUE) {
		emit(KIND_DS, data, len);
	}
	return BT_GATT_ITER_CONTINUE;
}

/* Where Zephyr delivers the two characteristics. No CCC write here; never restored at a later connection. */
static int add_sub(const struct bt_conn_info *info, struct bt_gatt_subscribe_params *p)
{
	memset(p, 0, sizeof(*p));
	p->notify = received;
	p->value = BT_GATT_CCC_NOTIFY;
	p->ccc_handle = p == &ns_sub ? ns_ccc : ds_ccc;
	p->value_handle = p == &ns_sub ? ns_value : ds_value;
	atomic_set_bit(p->flags, BT_GATT_SUBSCRIBE_FLAG_VOLATILE);
	return bt_gatt_resubscribe(info->id, info->le.dst, p);
}

/* The handles are known. A subscription from an earlier session of this link only needs them updated. */
static void subscribe(void)
{
	struct bt_conn_info info;

	if (subs_added) {
		ns_sub.value_handle = ns_value;
		ns_sub.ccc_handle = ns_ccc;
		ds_sub.value_handle = ds_value;
		ds_sub.ccc_handle = ds_ccc;
	} else {
		if (bt_conn_get_info(relay_conn, &info) || add_sub(&info, &ns_sub)) {
			fail(STATUS_FAILED);
			return;
		}
		subs_added = true;
		if (add_sub(&info, &ds_sub)) {
			fail(STATUS_FAILED);
			return;
		}
	}
	stage = S_SUB_DS;
	ds_on = true;
	if (write_ccc(ds_ccc, ccc_on)) {
		fail(STATUS_FAILED);
	}
}

static void ccc_done(struct bt_conn *c, uint8_t err, struct bt_gatt_write_params *p)
{
	if (stage == S_CLOSE_NS || stage == S_CLOSE_DS) {
		close_next();
		return;
	}
	if (stop_taken()) {
		return;
	}
	if (err) {
		fail(STATUS_FAILED);
		return;
	}
	switch (stage) {
	case S_SUB_DS:
		/* Set from an earlier session or not, only a new subscription makes iOS list what it has. */
		stage = S_NS_OFF;
		if (write_ccc(ns_ccc, ccc_off)) {
			fail(STATUS_FAILED);
		}
		break;
	case S_NS_OFF:
		stage = S_SUB_NS;
		ns_on = true;
		if (write_ccc(ns_ccc, ccc_on)) {
			fail(STATUS_FAILED);
		}
		break;
	case S_SUB_NS:
		stage = S_ACTIVE;
		LOG_INF("relay ready");
		emit_status(STATUS_READY);
		break;
	default:
		break;
	}
}

static uint8_t found(struct bt_conn *c, const struct bt_gatt_attr *attr, struct bt_gatt_discover_params *p);

static void find(enum stage next, uint8_t type, const struct bt_uuid *uuid, uint16_t start, uint16_t end)
{
	stage = next;
	discover = (struct bt_gatt_discover_params){.uuid = uuid, .func = found, .type = type, .end_handle = end};
	discover.start_handle = start;
	if (start > end || bt_gatt_discover(relay_conn, &discover)) {
		fail(STATUS_FAILED);
	}
}

/* iOS adds and removes ANCS as it pleases (Share System Notifications), so each session looks for it again. */
static void find_service(void)
{
	service_end = ns_value = ns_ccc = cp_value = ds_value = ds_ccc = 0;
	find(S_FIND_SERVICE, BT_GATT_DISCOVER_PRIMARY, &ancs_uuid.uuid, BT_ATT_FIRST_ATTRIBUTE_HANDLE,
	     BT_ATT_LAST_ATTRIBUTE_HANDLE);
}

static uint8_t found(struct bt_conn *c, const struct bt_gatt_attr *attr, struct bt_gatt_discover_params *p)
{
	if (stop_taken()) {
		return BT_GATT_ITER_STOP;
	}
	switch (stage) {
	case S_FIND_SERVICE:
		if (!attr) {
			fail(STATUS_NO_ANCS);
			break;
		}
		service_end = ((struct bt_gatt_service_val *)attr->user_data)->end_handle;
		find(S_FIND_CHARS, BT_GATT_DISCOVER_CHARACTERISTIC, NULL, attr->handle + 1, service_end);
		break;
	case S_FIND_CHARS:
		if (attr) {
			const struct bt_gatt_chrc *chrc = attr->user_data;

			if (!bt_uuid_cmp(chrc->uuid, &ns_uuid.uuid)) {
				ns_value = chrc->value_handle;
			} else if (!bt_uuid_cmp(chrc->uuid, &cp_uuid.uuid)) {
				cp_value = chrc->value_handle;
			} else if (!bt_uuid_cmp(chrc->uuid, &ds_uuid.uuid)) {
				ds_value = chrc->value_handle;
			}
			return BT_GATT_ITER_CONTINUE;
		}
		if (!ns_value || !cp_value || !ds_value) {
			fail(STATUS_FAILED);
			break;
		}
		find(S_FIND_NS_CCC, BT_GATT_DISCOVER_DESCRIPTOR, &ccc_uuid.uuid, ns_value + 1, service_end);
		break;
	case S_FIND_NS_CCC:
		if (!attr) {
			fail(STATUS_FAILED);
			break;
		}
		ns_ccc = attr->handle;
		find(S_FIND_DS_CCC, BT_GATT_DISCOVER_DESCRIPTOR, &ccc_uuid.uuid, ds_value + 1, service_end);
		break;
	case S_FIND_DS_CCC:
		if (!attr) {
			fail(STATUS_FAILED);
			break;
		}
		ds_ccc = attr->handle;
		subscribe();
		break;
	default:
		break;
	}
	return BT_GATT_ITER_STOP;
}

static void cp_done(struct bt_conn *c, uint8_t err, struct bt_gatt_write_params *p)
{
	cp_busy = false;
	if (stage != S_ACTIVE) {
		return;
	}
	if (err) {
		emit_status(STATUS_FAILED);
	} else {
		emit(KIND_CP_DONE, NULL, 0);
	}
}

/* Only ANCS's own commands: this must never become a way to write any handle on the phone. */
static bool cp_valid(const uint8_t *cp, uint16_t size)
{
	return (cp[0] == 0 && size >= 6) ||
	       (cp[0] == 1 && size >= 4 && cp[size - 2] == 0 && cp[size - 1] == 0) ||
	       (cp[0] == 2 && size == 6 && cp[5] <= 1);
}

/* A write to ANCS from the link's host: 0 or an ATT error. Who may write was checked by the caller. */
uint8_t ancs_command(struct bt_conn *c, const uint8_t *v, uint16_t len)
{
	uint32_t t;

	if (len < CMD_HEAD || v[0] != 'A' || v[1] != 'N' || v[2] != 1 || v[3] > CMD_CP) {
		return BT_ATT_ERR_INVALID_ATTRIBUTE_LEN;
	}
	t = get32(&v[4]);
	if (!t) {
		return BT_ATT_ERR_INVALID_ATTRIBUTE_LEN;
	}
	switch (v[3]) {
	case CMD_START:
		if (len != CMD_HEAD) {
			return BT_ATT_ERR_INVALID_ATTRIBUTE_LEN;
		}
		/* An answer outstanding from before could otherwise be taken for this session's. */
		if ((stage != S_IDLE && stage != S_ACTIVE) || (relay_conn && relay_conn != c)) {
			return BT_ATT_ERR_AUTHORIZATION;
		}
		ring_flush();
		if (!relay_conn) {
			k_spinlock_key_t key = k_spin_lock(&ring_lock);

			relay_conn = bt_conn_ref(c);
			k_spin_unlock(&ring_lock, key);
		}
		token = t;
		sequence = 0;
		emit_status(STATUS_RESETTING);
		find_service();
		return 0;
	case CMD_STOP:
		if (len != CMD_HEAD) {
			return BT_ATT_ERR_INVALID_ATTRIBUTE_LEN;
		}
		if (c != relay_conn || t != token) {
			return BT_ATT_ERR_AUTHORIZATION;
		}
		ring_flush();
		if (stage == S_ACTIVE) {
			close_relay();
		} else if (stage != S_CLOSE_NS && stage != S_CLOSE_DS) {
			stop_pending = true;
		}
		return 0;
	default:
		if (c != relay_conn || t != token) {
			return BT_ATT_ERR_AUTHORIZATION;
		}
		if (stage != S_ACTIVE || len <= CMD_HEAD || len > MAX_CMD || !cp_valid(&v[CMD_HEAD], len - CMD_HEAD)) {
			return BT_ATT_ERR_INVALID_ATTRIBUTE_LEN;
		}
		if (cp_busy) {
			return BT_ATT_ERR_INSUFFICIENT_RESOURCES;
		}
		memcpy(cp_buf, &v[CMD_HEAD], len - CMD_HEAD);
		cp_write = (struct bt_gatt_write_params){
			.func = cp_done, .handle = cp_value, .data = cp_buf, .length = len - CMD_HEAD,
		};
		if (bt_gatt_write(c, &cp_write)) {
			return BT_ATT_ERR_INSUFFICIENT_RESOURCES;
		}
		cp_busy = true;
		return 0;
	}
}

/* The link is gone: Zephyr has failed every request and dropped the subscriptions by now. */
void ancs_link_down(void)
{
	k_spinlock_key_t key = k_spin_lock(&ring_lock);
	struct bt_conn *c = relay_conn;

	relay_conn = NULL;
	memset(ring, 0, sizeof(ring));
	ring_head = ring_used = 0;
	k_spin_unlock(&ring_lock, key);
	if (c) {
		bt_conn_unref(c);
	}
	memset(cp_buf, 0, sizeof(cp_buf));
	stage = S_IDLE;
	token = 0;
	stop_pending = ns_on = ds_on = subs_added = cp_busy = false;
}
```

## src/fc.c
```c
/* Faceclaw's display path (VM.md §6.11): the phone composes each eye's frame and sends what changed, as draw calls in
 * the records of Faceclaw's custom firmware for the G2 (the same record format, compression and calls), on the FC
 * characteristic. No VM instruction runs: the path takes the arena for its memory and stops any program.
 *
 *   BT thread:  fc_rx() copies packets into the receive ring and publishes whole records
 *   executor:   fc_run() inflates one record, checks its CRC, applies it and answers with EV_FC_ACK
 *
 * Nothing here trusts a record. Out of the case only a bonded host gets this far, but in the case anyone does. */
#include <string.h>
#include <zephyr/kernel.h>
#include <zephyr/logging/log.h>
#include <zephyr/sys/crc.h>
#include "fc_inflate.h"
#include "g1.h"

LOG_MODULE_REGISTER(fc, LOG_LEVEL_INF);

#define FC_VERSION 1

/* The arena: 1 KiB left to the VM's registers and table, the frame, the inflater, the receive ring. */
#define FRAME_OFF 0x400
#define FRAME_SIZE (PANEL_ROW_BYTES * PANEL_H)
#define MAX_MESSAGE 16384u
#define Z_OFF (FRAME_OFF + FRAME_SIZE)
#define Z_SIZE (FC_Z_HISTORY + MAX_MESSAGE)
#define RX_OFF (Z_OFF + Z_SIZE)
#define RX_SIZE (ARENA_SIZE - RX_OFF)
#define REC_HDR 5
/* deflate can grow a message by little: 5 bytes per stored block, and the flush's own */
#define MAX_WIRE (MAX_MESSAGE + 256u)
BUILD_ASSERT(RX_OFF < ARENA_SIZE && RX_SIZE >= 3 * (REC_HDR + MAX_WIRE));

#define MAX_RECORDS 12
#define MAX_DIRTY 24

enum { OPT_START = 0x80, OPT_END = 0x40 };
enum { REC_LENSES = 3, REC_COMPRESSED = 4, REC_RESET = 8 };
enum { MSG_DRAW = 26, MSG_PRESENT = 28, MSG_BRIGHTNESS = 30, MSG_TYPE_MASK = 127 };
enum { OP_BBOX = 1, OP_CLEAR = 9 };
enum { KIND_ACK = 1, KIND_NACK = 3 };

struct record {
	uint32_t off;
	uint16_t len;
	uint8_t stream;
};

static uint8_t *arena;
static uint8_t *frame;
static uint8_t *rx_mem;

/* ring and record queue, shared by the BT thread and the executor */
static struct k_spinlock rx_lock;
static struct record records[MAX_RECORDS];
static uint8_t rec_tail, rec_count;
static uint32_t rx_wr, rx_rd;
static atomic_t rx_lost;   /* a record was dropped: the inflater's history no longer matches the sender's */

/* the record being received (BT thread only) */
static uint32_t cur_off, cur_fill, cur_need;
static uint8_t cur_stream;
static bool cur_open, cur_reserved;

/* executor only */
static struct fc_inflate z;
static bool ctx_ok, active;
static bool visible = true;
static struct fc_rect {
	uint16_t x, y, w, h;
} dirty[MAX_DIRTY];
static uint8_t dirty_n;
static bool dirty_all;

static uint32_t stats_records, stats_nacks, stats_unknown, stats_presents;

static uint8_t lens_mask(void)
{
	return board_role() == 1 ? 1 : 2;
}

static void answer(uint8_t kind, uint8_t stream, uint32_t size, uint16_t crc, bool block)
{
	uint8_t b[9] = {kind, stream, 0, 0, lens_mask()};

	put16(&b[5], (uint16_t)size);
	put16(&b[7], crc);
	proto_event(EV_FC_ACK, b, sizeof(b), block);
}

void fc_init(void)
{
	arena = exec_arena();
	frame = arena + FRAME_OFF;
	rx_mem = arena + RX_OFF;
	fc_inflate_init(&z, arena + Z_OFF, Z_SIZE);
}

/* ---------------------------------------------------------------- receiving (BT thread) */

static bool rx_reserve(uint32_t need, uint32_t *off)
{
	k_spinlock_key_t key = k_spin_lock(&rx_lock);
	bool ok = false;

	if (rec_count == 0) {
		rx_wr = 0;
		rx_rd = 0;
	}
	if (rx_wr >= rx_rd) {
		if (RX_SIZE - rx_wr >= need) {
			*off = rx_wr;
			ok = true;
		} else if (rx_rd > need) {
			*off = 0;
			ok = true;
		}
	} else if (rx_rd - rx_wr > need) {
		*off = rx_wr;
		ok = true;
	}
	if (ok) {
		rx_wr = *off + need;
	}
	k_spin_unlock(&rx_lock, key);
	return ok;
}

static void rx_abandon(void)
{
	if (cur_reserved) {
		k_spinlock_key_t key = k_spin_lock(&rx_lock);

		rx_wr = cur_off;
		k_spin_unlock(&rx_lock, key);
		cur_reserved = false;
	}
	cur_open = false;
}

static bool rx_publish(void)
{
	k_spinlock_key_t key = k_spin_lock(&rx_lock);
	bool ok = rec_count < MAX_RECORDS;

	if (ok) {
		struct record *r = &records[(rec_tail + rec_count) % MAX_RECORDS];

		r->off = cur_off;
		r->len = (uint16_t)cur_need;
		r->stream = cur_stream;
		if (rec_count == 0) {
			rx_rd = cur_off;
		}
		rec_count++;
	}
	k_spin_unlock(&rx_lock, key);
	return ok;
}

static void rx_drop(uint8_t stream)
{
	rx_abandon();
	atomic_set(&rx_lost, 1);
	answer(KIND_NACK, stream, 0, 0, false);
}

/* One packet: [opts: 0x80 first, 0x40 last][stream][the next bytes of the record] */
void fc_rx(const uint8_t *d, size_t len)
{
	const uint8_t *p = d + 2;
	size_t n;
	uint8_t opts, stream;

	if (len < 3) {
		return;
	}
	if (!arena || safe_level() != 0) {
		answer(KIND_NACK, d[1], 0, 0, false);
		return;
	}
	opts = d[0];
	stream = d[1];
	n = len - 2;
	if (opts & OPT_START) {
		uint32_t need;

		if (cur_open) {
			/* the last one never ended: it is lost, and the host hears so now rather than at its ACK deadline */
			rx_drop(cur_stream);
		}
		if (n < REC_HDR) {
			rx_drop(stream);
			return;
		}
		need = REC_HDR + (uint32_t)get16(p + 1);
		if (need > REC_HDR + MAX_WIRE || !rx_reserve(need, &cur_off)) {
			LOG_WRN("record of %u bytes refused", need);
			rx_drop(stream);
			return;
		}
		cur_reserved = true;
		cur_open = true;
		cur_stream = stream;
		cur_need = need;
		cur_fill = 0;
	} else if (!cur_open || stream != cur_stream) {
		/* the rest of a record already dropped: its first packet was answered */
		if (cur_open) {
			rx_drop(stream);
		}
		return;
	}
	if (n > cur_need - cur_fill) {
		rx_drop(stream);
		return;
	}
	memcpy(rx_mem + cur_off + cur_fill, p, n);
	cur_fill += n;
	if (opts & OPT_END) {
		if (cur_fill != cur_need || !rx_publish()) {
			rx_drop(stream);
			return;
		}
		cur_open = false;
		cur_reserved = false;
		exec_wake();
	}
}

void fc_link_down(void)
{
	rx_abandon();
	atomic_set(&rx_lost, 1);
}

/* ---------------------------------------------------------------- the frame */

static void add_dirty(int x, int y, int w, int h)
{
	if (dirty_all) {
		return;
	}
	if (dirty_n == MAX_DIRTY) {
		dirty_all = true;
		return;
	}
	dirty[dirty_n++] = (struct fc_rect){.x = x, .y = y, .w = w, .h = h};
}

/* n pixels of one colour from (x, y) in one row */
static void fill_span(int x, int y, int n, uint8_t color)
{
	uint8_t *row = frame + y * PANEL_ROW_BYTES;

	if (x & 1) {
		row[x / 2] = (row[x / 2] & 0xF0) | color;
		x++;
		n--;
	}
	if (n >= 2) {
		memset(row + x / 2, color * 0x11, n / 2);
		x += n & ~1;
		n &= 1;
	}
	if (n) {
		row[x / 2] = (row[x / 2] & 0x0F) | (uint8_t)(color << 4);
	}
}

/* A bbox's pixels: runs over exactly w x h pixels, left to right and top to bottom. One token is [count4|color4], for a
 * count of 1…15; [0|color4][count8]; or [0|color4][0][count16], little-endian. */
static int bbox_pixels(int x, int y, int w, int h, const uint8_t *p, uint32_t n)
{
	uint32_t left = (uint32_t)w * (uint32_t)h, i = 0;
	int cx = x, cy = y;

	while (i < n) {
		uint8_t color = p[i] & 0x0F;
		uint32_t count = p[i++] >> 4;

		if (!count) {
			if (i >= n) {
				return -EINVAL;
			}
			count = p[i++];
			if (!count) {
				if (n - i < 2) {
					return -EINVAL;
				}
				count = get16(p + i);
				i += 2;
				if (!count) {
					return -EINVAL;
				}
			}
		}
		if (count > left) {
			return -EINVAL;
		}
		left -= count;
		while (count) {
			int span = MIN((int)count, x + w - cx);

			fill_span(cx, cy, span, color);
			count -= span;
			cx += span;
			if (cx == x + w) {
				cx = x;
				cy++;
			}
		}
	}
	return left ? -EINVAL : 0;
}

static int call_bbox(const uint8_t *a, uint32_t n)
{
	int x, y, w, h;

	if (n < 1) {
		return -EINVAL;
	}
	if (a[0] == 0) {
		if (n < 5) {
			return -EINVAL;
		}
		x = a[1] * 4;
		y = a[2] * 2;
		w = a[3] * 4;
		h = a[4] * 2;
		a += 5;
		n -= 5;
	} else if (a[0] == 1) {
		if (n < 9) {
			return -EINVAL;
		}
		x = get16(a + 1);
		y = get16(a + 3);
		w = get16(a + 5);
		h = get16(a + 7);
		a += 9;
		n -= 9;
	} else {
		return -EINVAL;
	}
	if (w <= 0 || h <= 0 || x + w > PANEL_W || y + h > PANEL_H) {
		return -EINVAL;
	}
	if (bbox_pixels(x, y, w, h, a, n)) {
		/* a part of the rectangle has changed: show it right once the phone repeats the record */
		add_dirty(x, y, w, h);
		return -EINVAL;
	}
	add_dirty(x, y, w, h);
	return 0;
}

/* [count:u16]{length:u16, call}; a call is [op][flags: only 0, this path has no targets, depth or clips][args] */
static int draw_calls(const uint8_t *p, uint32_t n)
{
	uint32_t count, i = 2;

	if (n < 2) {
		return -EINVAL;
	}
	count = get16(p);
	for (uint32_t c = 0; c < count; c++) {
		uint32_t len;
		const uint8_t *call;
		int err = 0;

		if (n - i < 2) {
			return -EINVAL;
		}
		len = get16(p + i);
		i += 2;
		if (len < 2 || len > n - i) {
			return -EINVAL;
		}
		call = p + i;
		i += len;
		if (call[1] != 0) {
			return -EINVAL;
		}
		switch (call[0]) {
		case OP_BBOX:
			err = call_bbox(call + 2, len - 2);
			break;
		case OP_CLEAR:
			if (len < 3 || call[2] > 15) {
				return -EINVAL;
			}
			memset(frame, call[2] * 0x11, FRAME_SIZE);
			dirty_all = true;
			break;
		default:
			return -EINVAL;
		}
		if (err) {
			return err;
		}
		atomic_inc(&hb_exec);
	}
	return i == n ? 0 : -EINVAL;
}

/* The frame's changes to the panel, latched at once. A rectangle's x is rounded down to a whole byte of the frame. */
static void present(void)
{
	int x0 = PANEL_W, y0 = PANEL_H, x1 = 0, y1 = 0;
	uint32_t area = 0;

	stats_presents++;
	if (!visible) {
		return;   /* kept dirty until the panel may show it */
	}
	if (!panel_is_on()) {
		dirty_all = true;   /* off or in standby, the panel has lost its image */
	}
	if (dirty_all) {
		x0 = 0;
		y0 = 0;
		x1 = PANEL_W;
		y1 = PANEL_H;
		area = PANEL_W * PANEL_H;
	} else {
		for (int i = 0; i < dirty_n; i++) {
			x0 = MIN(x0, dirty[i].x & ~1);
			y0 = MIN(y0, dirty[i].y);
			x1 = MAX(x1, dirty[i].x + dirty[i].w);
			y1 = MAX(y1, dirty[i].y + dirty[i].h);
			area += (uint32_t)dirty[i].w * dirty[i].h;
		}
		if (!dirty_n) {
			return;
		}
	}
	atomic_inc(&hb_exec);
	if (dirty_all || area >= PANEL_W * PANEL_H / 2) {
		/* whole rows go out in bursts, faster than a window per row */
		if (exec_fc_panel_begin(0, y0, PANEL_W, y1 - y0)) {
			LOG_WRN("present: no panel");
			return;
		}
		for (int y = y0; y < y1; y++) {
			panel_rect_row(frame + y * PANEL_ROW_BYTES);
		}
	} else {
		if (exec_fc_panel_begin(x0, y0, x1 - x0, y1 - y0)) {
			LOG_WRN("present: no panel");
			return;
		}
		for (int i = 0; i < dirty_n; i++) {
			int x = dirty[i].x & ~1;
			int w = dirty[i].x + dirty[i].w - x;

			for (int y = dirty[i].y; y < dirty[i].y + dirty[i].h; y++) {
				panel_rect_span(x, y, w, frame + y * PANEL_ROW_BYTES + x / 2);
			}
			atomic_inc(&hb_exec);
		}
	}
	exec_fc_panel_end();
	dirty_n = 0;
	dirty_all = false;
}

/* [30][version = 1][target 0…100][visible][fade ms: u16]: no fade yet. Hidden, the panel waits in standby; shown again,
 * it comes back with the next PRESENT, which the phone sends with it. */
static int brightness(const uint8_t *m, uint32_t n)
{
	if (n < 4 || m[1] != 1 || m[2] > 100) {
		return -EINVAL;
	}
	exec_fc_brightness(MAX(1, (m[2] * PANEL_LEVEL_MAX + 50) / 100));
	if (visible && !m[3]) {
		exec_fc_panel(2);
		dirty_all = true;
	}
	visible = m[3] != 0;
	return 0;
}

static int apply(const uint8_t *m, uint32_t n)
{
	if (!n) {
		return 0;
	}
	switch (m[0] & MSG_TYPE_MASK) {
	case MSG_DRAW:
		return draw_calls(m + 1, n - 1);
	case MSG_PRESENT:
		present();
		return 0;
	case MSG_BRIGHTNESS:
		return brightness(m, n);
	default:
		/* a later phone's message: nothing here depends on it */
		stats_unknown++;
		return 0;
	}
}

/* ---------------------------------------------------------------- records (executor) */

static void open_session(void)
{
	if (active) {
		return;
	}
	exec_fc_stop_vm();
	memset(frame, 0, FRAME_SIZE);
	dirty_n = 0;
	dirty_all = true;
	visible = true;
	ctx_ok = false;
	active = true;
	LOG_INF("display path open");
}

static bool handle(const uint8_t *r, uint32_t n, uint32_t *size, uint16_t *crc)
{
	uint8_t flags = r[0];
	uint32_t wire = get16(r + 1);
	const uint8_t *msg = r + REC_HDR;
	uint32_t len = wire;
	bool ok;

	*size = 0;
	*crc = get16(r + 3);
	if (REC_HDR + wire != n) {
		return false;
	}
	open_session();
	if (flags & REC_RESET) {
		fc_inflate_reset(&z);
		ctx_ok = true;
		atomic_set(&rx_lost, 0);
	} else if (atomic_get(&rx_lost)) {
		ctx_ok = false;
	}
	if (flags & REC_COMPRESSED) {
		int err;

		if (!ctx_ok) {
			return false;
		}
		err = fc_inflate_record(&z, r + REC_HDR, wire, &msg, &len);
		if (err) {
			LOG_WRN("inflate: %d", err);
			ctx_ok = false;
			return false;
		}
	} else if (len > MAX_MESSAGE) {
		return false;
	}
	*size = len;
	if (crc16_itu_t(0xFFFF, msg, len) != *crc) {
		LOG_WRN("record CRC: size %u", len);
		ctx_ok = false;
		return false;
	}
	ok = apply(msg, len) == 0;
	if (!ok) {
		LOG_WRN("message %u of %u bytes refused", len ? msg[0] : 0, len);
	}
	if (flags & REC_COMPRESSED) {
		fc_inflate_commit(&z);
	}
	return ok;
}

bool fc_pending(void)
{
	return rec_count != 0;
}

/* One record per call, so the executor's loop keeps its cadence. */
void fc_run(void)
{
	struct record r;
	k_spinlock_key_t key = k_spin_lock(&rx_lock);
	uint32_t size = 0;
	uint16_t crc = 0;
	bool ok;

	if (!rec_count) {
		k_spin_unlock(&rx_lock, key);
		return;
	}
	r = records[rec_tail];
	k_spin_unlock(&rx_lock, key);

	ok = safe_level() == 0 && handle(rx_mem + r.off, r.len, &size, &crc);
	stats_records++;
	stats_nacks += !ok;

	key = k_spin_lock(&rx_lock);
	rec_tail = (rec_tail + 1) % MAX_RECORDS;
	rec_count--;
	rx_rd = rec_count ? records[rec_tail].off : rx_wr;
	k_spin_unlock(&rx_lock, key);

	atomic_inc(&hb_exec);
	answer(ok ? KIND_ACK : KIND_NACK, r.stream, ok ? size : 0, crc, true);
}

/* The microphone stopped: its indicator was cleared to black on the panel, over whatever the frame has there. */
void fc_indicator_cleared(void)
{
	if (active) {
		add_dirty(board_role() == 1 ? 4 : 620, 4, 16, 16);
		present();
	}
}

/* RESET_SESSION: the arena is the VM's again, whatever the path held there is gone. Executor. */
void fc_reset(void)
{
	k_spinlock_key_t key = k_spin_lock(&rx_lock);

	rec_tail = 0;
	rec_count = 0;
	rx_wr = 0;
	rx_rd = 0;
	k_spin_unlock(&rx_lock, key);
	atomic_set(&rx_lost, 1);
	active = false;
	ctx_ok = false;
}

/* FC_INFO's body (VM.md §6.11): u8 version, u8 flags (bit 0 the path is open), u16 max_message, u16 max_wire, u32 rx_size,
 * u32 history */
size_t fc_info(uint8_t *b)
{
	b[0] = FC_VERSION;
	b[1] = active ? 1 : 0;
	put16(&b[2], MAX_MESSAGE);
	put16(&b[4], MAX_WIRE);
	put32(&b[6], RX_SIZE);
	put32(&b[10], FC_Z_HISTORY);
	put32(&b[14], stats_records);
	put32(&b[18], stats_nacks);
	put32(&b[22], stats_presents);
	return 26;
}
```
